## esp32_s3_firmware/main/Kconfig.projbuild
```kconfig
menu "OpenClaw ESP32-S3 Configuration"

    config OPENCLAW_WIFI_SSID
        string "Wi-Fi SSID"
        default ""
        help
            Local Wi-Fi network used by both the iPhone and ESP32-S3.
            Do not commit the generated sdkconfig file.

    config OPENCLAW_WIFI_PASSWORD
        string "Wi-Fi password"
        default ""
        help
            WPA/WPA2 password. The generated sdkconfig file is ignored by Git.

    config OPENCLAW_WIFI_MAXIMUM_RETRY
        int "Maximum Wi-Fi retries"
        range 1 100
        default 10

    config OPENCLAW_HTTP_PORT
        int "HTTP control port"
        range 1 65535
        default 3333

    config OPENCLAW_OVERHEAT_CELSIUS
        int "Pause HID control at chip temperature (C)"
        range 45 75
        default 70
        help
            Internal sensor is a trend indicator, not a precision thermometer.
            Control resumes after cooling five degrees below this threshold.

endmenu
```

## esp32_s3_firmware/sdkconfig.defaults
```kconfig
CONFIG_BT_ENABLED=y
CONFIG_BT_BLUEDROID_ENABLED=y
CONFIG_BT_NIMBLE_ENABLED=n
CONFIG_BT_BLE_ENABLED=y
CONFIG_BT_BLE_42_FEATURES_SUPPORTED=y
CONFIG_BT_BLE_50_FEATURES_SUPPORTED=y
CONFIG_BT_GATTS_ENABLE=y
CONFIG_BT_GATT_MAX_SR_PROFILES=8
CONFIG_PARTITION_TABLE_SINGLE_APP_LARGE=y
CONFIG_COMPILER_OPTIMIZATION_DEFAULT=y
CONFIG_ESP_MAIN_TASK_STACK_SIZE=6144
CONFIG_HTTPD_MAX_REQ_HDR_LEN=1024
CONFIG_ESPTOOLPY_FLASHSIZE_16MB=y
```
